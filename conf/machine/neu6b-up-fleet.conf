## conf/machine/neu6b-up-fleet.conf
```bitbake
# Copyright (C) 2023 Edgeble AI Technologies Pvt. Ltd.
# Released under the MIT license (see COPYING.MIT for the terms)

#@TYPE: Machine
#@NAME: Edgeble Neural Compute Module 6B
#@DESCRIPTION: Edgeble Neural Compute Module 6B

require conf/machine/include/rk3588.inc

SOC_FAMILY = "rk3588"

# kernel
PREFERRED_PROVIDER_virtual/kernel = "linux-kernel-openaia"
PREFERRED_VERSION_linux-kernel = "6.7-rc1"
LINUX_VERSION = "6.7"
PREFERRED_VERSION_linux-libc-headers = "6.7"
LINUXLIBCVERSION = "6.7"
KERNEL_VERSION_SANITY_SKIP="1"

# kernel dtb
KERNEL_DEVICETREE = " \
    rockchip/rk3588-edgeble-neu6b-io.dtb \
    "

# kernel defconfig
KBUILD_DEFCONFIG = "defconfig"

# u-boot
PREFERRED_PROVIDER_virtual/bootloader = "u-boot-neu6b-openaia"
PREFERRED_VERSION_u-boot = "2023.07-%"

# u-boot defconfig
UBOOT_MACHINE = "neu6b-io-rk3588_defconfig"

# xz
IMAGE_FSTYPES += "wic.xz wic.bmap ext4.gz"

# wic
WKS_FILE = "rockchip-swu.wks"

MACHINE_FEATURES:append  = "ext2 ext3 usbhost usbgadget bluetooth"
DISTRO_FEATURES:append = "systemd bluetooth wifi"


IMAGE_INSTALL:append = " \
    kernel-modules \
    i2c-tools \
    alsa-utils \
    canutils \
    evtest \
    iperf3 \
    minicom \
    ppp \
    usbutils \
    pciutils \
    libgcc \
    libubootenv-bin \
    swupdate \
"
```
